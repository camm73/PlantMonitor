## main/Kconfig.projbuild
```kconfig
menu "ESP WiFi Settings"

    config ESP_WIFI_SSID
        string "WiFi SSID"
        default "myssid"
        help
            SSID (network name) for the example to connect to.

    config ESP_WIFI_PASSWORD
        string "WiFi Password"
        default "mypassword"
        help
            WiFi password (WPA or WPA2) for the example to use.

    config ESP_MAXIMUM_RETRY
        int "Maximum retry"
        default 5
        help
            Set the Maximum retry to avoid station reconnecting to the AP unlimited when the AP is really inexistent.
endmenu

menu "AWS IoT Settings"
    config AWS_IOT_THING_NAME
        string "AWS IoT Thing Name"
        default "THING NAME"
        help
            AWS IoT Thing Name

    config AWS_IOT_CLIENT_ID
        string "AWS IoT Client ID"
        default "CLIENT"
        help
            AWS IoT Client Name
endmenu
```
